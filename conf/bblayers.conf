## conf/bblayers.conf
```bitbake
#
# Copyright 2021, Mattias Waldo
#
# SPDX-License-Identifier: GPL-2.0-only
#

# POKY_BBLAYERS_CONF_VERSION is increased each time build/conf/bblayers.conf
# changes incompatibly
POKY_BBLAYERS_CONF_VERSION = "2"

BBPATH = "${TOPDIR}"
BBFILES ?= ""

BBLAYERS ?= " \
  /home/yoctouser/work/meta \
  /home/yoctouser/work/meta-poky \
  /home/yoctouser/work/meta-yocto-bsp \
  /home/yoctouser/work/meta-sel4 \
  /home/yoctouser/work/meta-cloud-services \
  /home/yoctouser/work/meta-openembedded/meta-oe \
  /home/yoctouser/work/meta-openembedded/meta-filesystems \
  /home/yoctouser/work/meta-openembedded/meta-networking \
  /home/yoctouser/work/meta-openembedded/meta-python \
  /home/yoctouser/work/meta-openembedded/meta-webserver \
  /home/yoctouser/work/meta-cloud-services/meta-openstack \
  /home/yoctouser/work/meta-virtualization \
  "
```
